## s40/kernel/overlay/arch/arm/mach-nokia-raps/Kconfig
```kconfig
# SPDX-License-Identifier: GPL-2.0-only
config ARCH_NOKIA_RAPS
	bool "Nokia 6303 classic (RM-443)"
	depends on ARCH_MULTI_V5 && CPU_LITTLE_ENDIAN
	select CPU_ARM926T
	select IRQ_DOMAIN
	select TIMER_OF
	select FONT_SUPPORT
	select FONT_8x16
	select INPUT
	select INPUT_EVDEV
	select WATCHDOG
	select WATCHDOG_CORE
	select WATCHDOG_SYSFS
	select WATCHDOG_HANDLE_BOOT_ENABLED
	select SERIAL_CORE
	select SERIAL_CORE_CONSOLE
	select SERIAL_EARLYCON
	help
	  Platform support for the Nokia 6303 classic: interrupts, timers,
	  display, keypad, watchdogs, USB, SD storage and RAM logging.

config RM443_INSPECT
	bool "Read-only RM-443 retained-state inspection"
	depends on ARCH_NOKIA_RAPS && !SMP
	default n
	help
	  Expose bounded reserved boot records and captured page-table snapshots
	  under /sys/firmware/rm443_inspect, only with rm443.inspect=1. This does
	  not expose general RAM, ROM, device registers or writable mappings.

config RM443_PROBE
	bool "RM-443 privileged runtime experiments"
	depends on ARCH_NOKIA_RAPS && !SMP
	default n
	help
	  Provide /dev/rm443_probe for explicit RAM uploads, ROM calls, uploaded
	  ARM/Thumb routines and width-specific physical or bridge-mapped reads.
	  Requires CAP_SYS_RAWIO. Registration does not run experiments. A hung
	  call or hardware bus access may require a reboot.
```

## s40/kernel/overlay/drivers/dma/Kconfig.raps
```kconfig
# SPDX-License-Identifier: GPL-2.0-only
config RAPS_DMA
	bool "RAPS linear DMA controller"
	depends on ARCH_NOKIA_RAPS
	select DMA_ENGINE
	select DMA_VIRTUAL_CHANNELS
	help
	  Interrupt-driven, 32-bit memory-to-LCD transfers on RAPS.
```

## s40/kernel/overlay/drivers/gpu/drm/raps/Kconfig
```kconfig
# SPDX-License-Identifier: GPL-2.0-only
config DRM_RM443
	bool "RAPS LCD controller"
	depends on DRM && ARCH_NOKIA_RAPS
	select DRM_KMS_HELPER
	select DRM_GEM_DMA_HELPER
	help
	  Command-mode 240x320 display on Nokia RM-443. Provides atomic KMS,
	  memory-backed framebuffers and damage updates to the LCD FIFO.
	  The panel power and bus timing must be initialized by the boot firmware.
```
